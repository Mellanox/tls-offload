## drivers/net/ethernet/mellanox/accelerator/core/Kconfig
```kconfig
#
# Mellanox accelerator core driver configuration
#

config MLX_ACCEL_CORE
	tristate "Mellanox Technologies ConnectX-4 accelerator core driver"
	depends on MLX5_INFINIBAND && MLX5_CORE_EN && MLX5_CORE
	default n
	---help---
	  Core driver for low level functionality of the ConnectX-4 accelerator
	  by Mellanox Technologies.

config MLX_ACCEL_QP_SIMULATOR
	bool
	depends on MLX_ACCEL_CORE
	default y
	---help---
	  Use QP based simulator instead of the actual FPGA.
```

## drivers/net/ethernet/mellanox/accelerator/ipsec/Kconfig
```kconfig
#
# Mellanox ipsec accelerator driver configuration
#

config MLX_ACCEL_IPSEC
	tristate "Mellanox Technologies IPSec accelarator driver"
	depends on MLX_ACCEL_CORE
	depends on XFRM_OFFLOAD
	depends on INET_ESP_OFFLOAD || INET6_ESP_OFFLOAD
	default n
	---help---
	  IPsec accelarator driver by Mellanox Technologies.
```

## drivers/net/ethernet/mellanox/accelerator/tls/Kconfig
```kconfig
#
# Mellanox tls accelerator driver configuration
#

config MLX_ACCEL_TLS
	tristate "Mellanox Technologies TLS accelarator driver"
	depends on MLX_ACCEL_CORE
	default n
	---help---
	  TLS accelarator driver by Mellanox Technologies.
```

## drivers/net/ethernet/mellanox/accelerator/tools/Kconfig
```kconfig
#
# Mellanox accelerator tools driver configuration
#

config MLX_ACCEL_TOOLS
	tristate "Mellanox Technologies accelarator tools driver"
	depends on MLX_ACCEL_CORE
	default n
	---help---
	  Accelarator tools driver by Mellanox Technologies.
```

## net/tls/Kconfig
```kconfig
#
# TLS configuration
#
config TLS
	tristate "Transport Layer Security support"
	depends on NET
	default m
	---help---
	Enable kernel support for TLS protocol. This allows processing
	of protocol in kernel as well as oflloading it to HW.

	If unsure, say N.
```
